## components/cyd_display/Kconfig
```kconfig
menu "Display support"

config WAVESHARE_C6_LCD_1_47
    bool "Waveshare ESP32-C6-LCD-1.47 router dashboard"
    depends on IDF_TARGET_ESP32C6
    default n
    help
        Enable the onboard 172x320 ST7789 display on the Waveshare
        ESP32-C6-LCD-1.47. The dashboard is status-only because this board
        has no touch controller. GPIO6/7 drive SPI, GPIO14 is CS, GPIO15 is
        DC, GPIO21 is reset, and GPIO22 controls the backlight.

endmenu
```

## sdkconfig.defaults.cyd
```kconfig
# ESP32-2432S028 dual-USB CYD2USB profile (ST7789 mode 3)
CONFIG_CYD_DISPLAY=y
CONFIG_ESPTOOLPY_FLASHSIZE_4MB=y
CONFIG_ESPTOOLPY_FLASHSIZE="4MB"
CONFIG_PARTITION_TABLE_CUSTOM=y
CONFIG_PARTITION_TABLE_CUSTOM_FILENAME="partitions_cyd_4mb.csv"
CONFIG_STORE_HISTORY=n
CONFIG_LV_COLOR_16_SWAP=y
CONFIG_LV_MEM_SIZE_KILOBYTES=32
CONFIG_LV_FONT_MONTSERRAT_16=y
CONFIG_LV_FONT_MONTSERRAT_20=y
CONFIG_XPT2046_CONVERT_ADC_TO_COORDS=n
```

## sdkconfig.defaults.esp32c6_uart
```kconfig
# ESP32-DevKit-C6 V1.3 with onboard CH343 UART bridge
CONFIG_ESP_CONSOLE_UART_DEFAULT=y
CONFIG_ESP_CONSOLE_USB_SERIAL_JTAG=n
```

## sdkconfig.defaults.esp32s3
```kconfig
# ESP32-S3 N16R8 target overrides

# 16 MB Quad flash (hardware verified on HW-678 N16R8)
CONFIG_ESPTOOLPY_FLASHSIZE_4MB=n
CONFIG_ESPTOOLPY_FLASHSIZE_16MB=y
CONFIG_ESPTOOLPY_FLASHSIZE="16MB"
CONFIG_ESPTOOLPY_FLASHFREQ_80M=n
CONFIG_ESPTOOLPY_FLASHFREQ_40M=y
CONFIG_ESPTOOLPY_FLASHFREQ="40m"

# Larger OTA slots and storage for 16 MB devices
CONFIG_PARTITION_TABLE_CUSTOM=y
CONFIG_PARTITION_TABLE_CUSTOM_FILENAME="partitions_16mb.csv"

# The router does not require external RAM. Keep PSRAM disabled for broad
# N16R8 board compatibility; the full 8 MB remains available for a later,
# board-specific performance profile.
CONFIG_SPIRAM=n

# Primary interactive console on native USB Serial/JTAG.
CONFIG_ESP_CONSOLE_UART_DEFAULT=n
CONFIG_ESP_CONSOLE_USB_SERIAL_JTAG=y
CONFIG_ESP_CONSOLE_SECONDARY_USB_SERIAL_JTAG=n
```

## sdkconfig.defaults.waveshare_c6_lcd_1_47
```kconfig
# Waveshare ESP32-C6-LCD-1.47 display profile.
CONFIG_WAVESHARE_C6_LCD_1_47=y
CONFIG_LV_FONT_MONTSERRAT_16=y
CONFIG_LV_FONT_MONTSERRAT_20=y
CONFIG_PARTITION_TABLE_CUSTOM=y
CONFIG_PARTITION_TABLE_CUSTOM_FILENAME="partitions_waveshare_c6_lcd_1_47.csv"
```
